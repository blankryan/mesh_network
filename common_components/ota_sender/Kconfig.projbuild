## common_components/ota_sender/Kconfig.projbuild
```kconfig
# This menu used to live in main/Kconfig.projbuild guarded by
# `depends on MESH_NODE_ROLE_GATEWAY`. Now that the gateway is its own product
# and this component is only a dependency of that product, the guard (and the
# whole MESH_NODE_ROLE choice) is gone: the menu simply doesn't exist in the
# worker's menuconfig because the worker never pulls this component in.

menu "Gateway OTA sender"

choice GATEWAY_OTA_SOURCE
    prompt "Firmware source for a push"
    default GATEWAY_OTA_SRC_LOOPBACK
    help
        Where the gateway gets the image it pushes to a worker over ESP-NOW.

    config GATEWAY_OTA_SRC_LOOPBACK
        bool "Loopback (stream the gateway's own running app) - no AP needed"
        help
            Sends a copy of the gateway's running firmware to the target worker.
            Lets you exercise the responder + rollback end-to-end on the bench
            without an HTTP server. (The worker then runs the gateway image.)

    config GATEWAY_OTA_SRC_HTTP
        bool "HTTP/HTTPS download (leg 1) then ESP-NOW push (leg 2)"
        help
            Connects to an AP, downloads a worker image into a flash staging
            slot, returns to the ESP-NOW channel, then pushes it. Production path.

endchoice

config GATEWAY_OTA_HTTP_URL
    string "Firmware image URL"
    depends on GATEWAY_OTA_SRC_HTTP
    default "https://example.com/worker.bin"

config GATEWAY_OTA_WIFI_SSID
    string "Wi-Fi SSID for the leg-1 download"
    depends on GATEWAY_OTA_SRC_HTTP
    default "myssid"

config GATEWAY_OTA_WIFI_PASS
    string "Wi-Fi password for the leg-1 download"
    depends on GATEWAY_OTA_SRC_HTTP
    default "mypassword"

endmenu
```

## main/Kconfig.projbuild
```kconfig
menu "Mesh Network (build role)"

choice MESH_NODE_ROLE
    prompt "Node role / firmware image to build"
    default MESH_NODE_ROLE_WORKER
    help
        This single ESP-IDF project builds two distinct firmwares that each
        define their own app_main(): the ESP-NOW worker and the gateway.
        Exactly one role's source file is compiled per build configuration.

        Pick the role here (or, preferably, let the multi-config defaults files
        select it: sdkconfig.worker / sdkconfig.gateway). See the README section
        "Multiple build configurations".

    config MESH_NODE_ROLE_WORKER
        bool "Worker  (ESP32 + SSD1306 OLED, ESP-NOW sensor node)"
        help
            Compiles worker_main.c. Intended target: esp32.

    config MESH_NODE_ROLE_GATEWAY
        bool "Gateway (ESP32-S3 + ILI9488 TFT, ESP-NOW receiver)"
        help
            Compiles gateway_main.c. Intended target: esp32s3. Pulls the
            atanisoft/esp_lcd_ili9488 managed component (see idf_component.yml).

endchoice

endmenu

menu "Gateway OTA sender"
    depends on MESH_NODE_ROLE_GATEWAY

choice GATEWAY_OTA_SOURCE
    prompt "Firmware source for a push"
    default GATEWAY_OTA_SRC_LOOPBACK
    help
        Where the gateway gets the image it pushes to a worker over ESP-NOW.

    config GATEWAY_OTA_SRC_LOOPBACK
        bool "Loopback (stream the gateway's own running app) - no AP needed"
        help
            Sends a copy of the gateway's running firmware to the target worker.
            Lets you exercise the responder + rollback end-to-end on the bench
            without an HTTP server. (The worker then runs the gateway image.)

    config GATEWAY_OTA_SRC_HTTP
        bool "HTTP/HTTPS download (leg 1) then ESP-NOW push (leg 2)"
        help
            Connects to an AP, downloads a worker image into a flash staging
            slot, returns to the ESP-NOW channel, then pushes it. Production path.

endchoice

config GATEWAY_OTA_HTTP_URL
    string "Firmware image URL"
    depends on GATEWAY_OTA_SRC_HTTP
    default "https://example.com/worker.bin"

config GATEWAY_OTA_WIFI_SSID
    string "Wi-Fi SSID for the leg-1 download"
    depends on GATEWAY_OTA_SRC_HTTP
    default "myssid"

config GATEWAY_OTA_WIFI_PASS
    string "Wi-Fi password for the leg-1 download"
    depends on GATEWAY_OTA_SRC_HTTP
    default "mypassword"

endmenu
```

## products/gateway/sdkconfig.defaults
```kconfig
# --- Flash for gateway (esp32s3) --------------------------------------------------------------------
# Both reference boards are 16 MB (per the architecture / OTA docs).
CONFIG_ESPTOOLPY_FLASHSIZE_16MB=y

# --- Partition table: OTA-ready --------------------------------------------- #
# Two app banks (ota_0 + ota_1, no factory) so esp_ota_* always has a
# non-running slot to write to. This is the baseline the OTA robustness doc
# assumes (esp_now_ota_robustness.md, sections 1 & 5). Harmless for the current
# data-path firmware; required once you wire in ESP-NOW OTA.
CONFIG_PARTITION_TABLE_TWO_OTA=y

# Needed only when the OTA sender's source is HTTP/HTTPS (CONFIG_GATEWAY_OTA_SRC_HTTP):
# esp_crt_bundle_attach() requires the certificate bundle. Harmless (and
# gc-stripped) for the default loopback source. The "Gateway OTA sender" menu
# itself now comes from common_components/ota_sender/Kconfig.projbuild.
CONFIG_MBEDTLS_CERTIFICATE_BUNDLE=y

# OTA rollback stays OFF for the gateway until it has its own self-test +
# esp_ota_mark_app_valid_cancel_rollback() call, otherwise every gateway OTA
# would revert on its second boot (esp_now_ota_robustness.md, section 6).
```

## products/gateway/sdkconfig.defaults.gateway
```kconfig
# Gateway product overrides, layered on top of the repo-root sdkconfig.defaults
# by this product's CMakePresets.json:
#   SDKCONFIG_DEFAULTS = "<repo>/sdkconfig.defaults;<here>/sdkconfig.defaults.gateway"
#
# The target (esp32s3) is set by the preset's IDF_TARGET cache variable, not here.
# There is no CONFIG_MESH_NODE_ROLE_* anymore: the role is the project itself
# (products/gateway compiles gateway_main.c, full stop).

# Needed only when the OTA sender's source is HTTP/HTTPS (CONFIG_GATEWAY_OTA_SRC_HTTP):
# esp_crt_bundle_attach() requires the certificate bundle. Harmless (and
# gc-stripped) for the default loopback source. The "Gateway OTA sender" menu
# itself now comes from common_components/ota_sender/Kconfig.projbuild.
CONFIG_MBEDTLS_CERTIFICATE_BUNDLE=y

# OTA rollback stays OFF for the gateway until it has its own self-test +
# esp_ota_mark_app_valid_cancel_rollback() call, otherwise every gateway OTA
# would revert on its second boot (esp_now_ota_robustness.md, section 6).
```

## products/worker/sdkconfig.defaults
```kconfig
# Worker product overrides, layered on top of the repo-root sdkconfig.defaults
# by this product's CMakePresets.json:
#   SDKCONFIG_DEFAULTS = "<repo>/sdkconfig.defaults;<here>/sdkconfig.defaults.worker"
#
# The target (esp32) is set by the preset's IDF_TARGET cache variable, not here.
# There is no CONFIG_MESH_NODE_ROLE_* anymore: the role is the project itself
# (products/worker compiles worker_main.c, full stop).

# Common defaults shared by EVERY product build (products/worker and
# products/gateway). Product-specific overrides live in each product directory
# (products/<p>/sdkconfig.defaults.<p>), which that product's CMakePresets.json
# layers on top of this file via SDKCONFIG_DEFAULTS. Targets are set by each
# preset's IDF_TARGET cache variable.

# --- Flash for worker node (esp32) --------------------------------------------------------------------
# Both reference boards are 4 MB (per the architecture / OTA docs).
CONFIG_ESPTOOLPY_FLASHSIZE_4MB=y

# --- Partition table: OTA-ready --------------------------------------------- #
# Two app banks (ota_0 + ota_1, no factory) so esp_ota_* always has a
# non-running slot to write to. This is the baseline the OTA robustness doc
# assumes (esp_now_ota_robustness.md, sections 1 & 5). Harmless for the current
# data-path firmware; required once you wire in ESP-NOW OTA.
CONFIG_PARTITION_TABLE_TWO_OTA=y

# OTA rollback: safe to enable now that the worker runs a PENDING_VERIFY
# self-test (common_components/ota_responder) and calls
# esp_ota_mark_app_valid_cancel_rollback() after a good boot. A crash/hang/
# power-loss before that confirm auto-rolls back.
# The bootloader RTC watchdog (CONFIG_BOOTLOADER_WDT_ENABLE) stays on by default.
CONFIG_BOOTLOADER_APP_ROLLBACK_ENABLE=y
```

## products/worker/sdkconfig.defaults.worker
```kconfig
# Worker product overrides, layered on top of the repo-root sdkconfig.defaults
# by this product's CMakePresets.json:
#   SDKCONFIG_DEFAULTS = "<repo>/sdkconfig.defaults;<here>/sdkconfig.defaults.worker"
#
# The target (esp32) is set by the preset's IDF_TARGET cache variable, not here.
# There is no CONFIG_MESH_NODE_ROLE_* anymore: the role is the project itself
# (products/worker compiles worker_main.c, full stop).

# OTA rollback: safe to enable now that the worker runs a PENDING_VERIFY
# self-test (common_components/ota_responder) and calls
# esp_ota_mark_app_valid_cancel_rollback() after a good boot. A crash/hang/
# power-loss before that confirm auto-rolls back.
# The bootloader RTC watchdog (CONFIG_BOOTLOADER_WDT_ENABLE) stays on by default.
CONFIG_BOOTLOADER_APP_ROLLBACK_ENABLE=y
```

## sdkconfig.defaults
```kconfig
# Common defaults shared by EVERY product build (products/worker and
# products/gateway). Product-specific overrides live in each product directory
# (products/<p>/sdkconfig.defaults.<p>), which that product's CMakePresets.json
# layers on top of this file via SDKCONFIG_DEFAULTS. Targets are set by each
# preset's IDF_TARGET cache variable.

# --- Flash --------------------------------------------------------------------
# Both reference boards are 4 MB (per the architecture / OTA docs).
CONFIG_ESPTOOLPY_FLASHSIZE_4MB=y

# --- Partition table: OTA-ready --------------------------------------------- #
# Two app banks (ota_0 + ota_1, no factory) so esp_ota_* always has a
# non-running slot to write to. This is the baseline the OTA robustness doc
# assumes (esp_now_ota_robustness.md, sections 1 & 5). Harmless for the current
# data-path firmware; required once you wire in ESP-NOW OTA.
CONFIG_PARTITION_TABLE_TWO_OTA=y

# --- OTA rollback ----------------------------------------------------------- #
# Rollback is enabled per-product, NOT here. The worker enables it
# (products/worker/sdkconfig.defaults.worker) because it implements the
# PENDING_VERIFY self-test in common_components/ota_responder. The gateway
# leaves it OFF until it has its own self-test +
# esp_ota_mark_app_valid_cancel_rollback() call, otherwise every gateway OTA
# would revert on its second boot (esp_now_ota_robustness.md, section 6).
# The bootloader RTC watchdog (CONFIG_BOOTLOADER_WDT_ENABLE) is on by default and
# should stay on.
```

## sdkconfig.defaults.gateway
```kconfig
# Gateway role overrides, layered on top of sdkconfig.defaults.
# Applied by the "gateway" preset in CMakePresets.json
# (SDKCONFIG_DEFAULTS="sdkconfig.defaults;sdkconfig.defaults.gateway").
#
# The target (esp32s3) is set by the preset's IDF_TARGET cache variable, not here.

# Compile gateway_main.c (ILI9488 TFT, node table). Pulls the
# atanisoft/esp_lcd_ili9488 managed component on first build. See main/Kconfig.projbuild.
CONFIG_MESH_NODE_ROLE_GATEWAY=y

# Needed only when the OTA sender's source is HTTP/HTTPS (CONFIG_GATEWAY_OTA_SRC_HTTP):
# esp_crt_bundle_attach() requires the certificate bundle. Harmless (and
# gc-stripped) for the default loopback source.
CONFIG_MBEDTLS_CERTIFICATE_BUNDLE=y
```

## sdkconfig.defaults.worker
```kconfig
# Worker role overrides, layered on top of sdkconfig.defaults.
# Applied by the "worker" preset in CMakePresets.json
# (SDKCONFIG_DEFAULTS="sdkconfig.defaults;sdkconfig.defaults.worker").
#
# The target (esp32) is set by the preset's IDF_TARGET cache variable, not here.

# Compile worker_main.c (SSD1306 OLED + dummy sensor). See main/Kconfig.projbuild.
CONFIG_MESH_NODE_ROLE_WORKER=y

# OTA rollback: safe to enable now that the worker runs a PENDING_VERIFY
# self-test (ota_responder.c) and calls esp_ota_mark_app_valid_cancel_rollback()
# after a good boot. A crash/hang/power-loss before that confirm auto-rolls back.
# The bootloader RTC watchdog (CONFIG_BOOTLOADER_WDT_ENABLE) stays on by default.
CONFIG_BOOTLOADER_APP_ROLLBACK_ENABLE=y
```
